## Documentation/devicetree/bindings/sound/ti,tas2557.yaml
```yaml
# SPDX-License-Identifier: (GPL-2.0-only OR BSD-2-Clause)
# Copyright (C) 2026
%YAML 1.2
---
$id: http://devicetree.org/schemas/sound/ti,tas2557.yaml#
$schema: http://devicetree.org/meta-schemas/core.yaml#

title: Texas Instruments TAS2557 Smart Amplifier

maintainers:
  - OpenCode Assistant <opencode@example.com>

description: |
  The TAS2557 is a mono, digital input Class-D audio amplifier with integrated
  speaker protection and DSP. It features speaker voltage and current sense for
  real-time monitoring, thermal protection, and advanced speaker protection
  algorithms.

  Specifications can be found at:
    https://www.ti.com/lit/gpn/tas2557

allOf:
  - $ref: dai-common.yaml#

properties:
  compatible:
    const: ti,tas2557

  reg:
    maxItems: 1
    description: |
      I2C address of the device, typically 0x4c or 0x4d

  reset-gpios:
    maxItems: 1
    description: GPIO used to reset the device (active low).

  irq-gpios:
    maxItems: 1
    description: GPIO used for interrupt signaling.

  interrupts:
    maxItems: 1
    description: Interrupt for fault reporting (thermal, overcurrent, etc).

  vdd-supply:
    description: Power supply for digital core (1.8V).

  vbat-supply:
    description: Battery/speaker supply voltage (3.6V-5.5V).

  pvdd-supply:
    description: Class-D output supply voltage.

  ti,imon-slot:
    $ref: /schemas/types.yaml#/definitions/uint32
    description: TDM TX time slot for current sense data.
    minimum: 0
    maximum: 15

  ti,vmon-slot:
    $ref: /schemas/types.yaml#/definitions/uint32
    description: TDM TX time slot for voltage sense data.
    minimum: 0
    maximum: 15

  '#sound-dai-cells':
    const: 0

required:
  - compatible
  - reg

unevaluatedProperties: false

examples:
  - |
    #include <dt-bindings/gpio/gpio.h>
    #include <dt-bindings/interrupt-controller/irq.h>

    i2c {
        #address-cells = <1>;
        #size-cells = <0>;

        codec@4c {
            compatible = "ti,tas2557";
            reg = <0x4c>;
            #sound-dai-cells = <0>;
            
            reset-gpios = <&tlmm 77 GPIO_ACTIVE_HIGH>;
            irq-gpios = <&tlmm 73 GPIO_ACTIVE_LOW>;
            
            interrupt-parent = <&tlmm>;
            interrupts = <73 IRQ_TYPE_LEVEL_LOW>;
            
            vdd-supply = <&pm8998_l1>;
            vbat-supply = <&battery>;
            pvdd-supply = <&pm8998_l6>;
            
            ti,imon-slot = <0>;
            ti,vmon-slot = <2>;
        };
    };
```
