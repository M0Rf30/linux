## Documentation/devicetree/bindings/media/i2c/samsung,s5k2l7.yaml
```yaml
# SPDX-License-Identifier: (GPL-2.0-only OR BSD-2-Clause)
%YAML 1.2
---
$id: http://devicetree.org/schemas/media/i2c/samsung,s5k2l7.yaml#
$schema: http://devicetree.org/meta-schemas/core.yaml#

title: Samsung S5K2L7 Image Sensor

maintainers:
  - Gianluca Boiano <morf3089@gmail.com>

description:
  The Samsung S5K2L7 is a 12 MP (4032x3024) Bayer CMOS image sensor with
  dual-pixel autofocus. It is controlled over I2C (CCI) and sends image data
  over a 4-lane MIPI CSI-2 D-PHY interface.

allOf:
  - $ref: /schemas/media/video-interface-devices.yaml#

properties:
  compatible:
    const: samsung,s5k2l7

  reg:
    maxItems: 1

  clocks:
    description:
      Input clock (EXTCLK).
    maxItems: 1

  vana-supply:
    description: Analog power supply (2.8 V).

  vdig-supply:
    description: Digital core power supply.

  vio-supply:
    description: Interface power supply (1.8 V).

  reset-gpios:
    description:
      Reset GPIO, active low (XSHUTDOWN).
    maxItems: 1

  port:
    $ref: /schemas/graph.yaml#/$defs/port-base
    additionalProperties: false

    properties:
      endpoint:
        $ref: /schemas/media/video-interfaces.yaml#
        unevaluatedProperties: false

        properties:
          data-lanes:
            items:
              - const: 1
              - const: 2
              - const: 3
              - const: 4

          link-frequencies:
            items:
              - const: 666000000
              - const: 351000000

        required:
          - data-lanes
          - link-frequencies

required:
  - compatible
  - reg
  - clocks
  - vana-supply
  - vdig-supply
  - vio-supply
  - port

unevaluatedProperties: false

examples:
  - |
    #include <dt-bindings/gpio/gpio.h>

    i2c {
        #address-cells = <1>;
        #size-cells = <0>;

        camera@10 {
            compatible = "samsung,s5k2l7";
            reg = <0x10>;

            clocks = <&camcc 0>;
            assigned-clocks = <&camcc 0>;
            assigned-clock-rates = <24000000>;

            reset-gpios = <&tlmm 40 GPIO_ACTIVE_LOW>;

            vana-supply = <&cam_vana>;
            vdig-supply = <&cam_vdig>;
            vio-supply = <&cam_vio>;

            orientation = <1>;
            rotation = <90>;

            port {
                endpoint {
                    data-lanes = <1 2 3 4>;
                    link-frequencies = /bits/ 64 <666000000 351000000>;
                    remote-endpoint = <&csiphy_ep>;
                };
            };
        };
    };
...
```

## Documentation/devicetree/bindings/media/i2c/samsung,s5k3t1.yaml
```yaml
# SPDX-License-Identifier: (GPL-2.0-only OR BSD-2-Clause)
%YAML 1.2
---
$id: http://devicetree.org/schemas/media/i2c/samsung,s5k3t1.yaml#
$schema: http://devicetree.org/meta-schemas/core.yaml#

title: Samsung S5K3T1 Image Sensor

maintainers:
  - Gianluca Boiano <morf3089@gmail.com>

description:
  Samsung S5K3T1 (ISOCELL 3T1) is a 20 MP (5184x3880) image sensor with 0.9 um
  pixels. The sensor is controlled over a serial camera control bus protocol
  and sends RAW10 image data over a 4-lane MIPI D-PHY CSI-2 interface.

allOf:
  - $ref: /schemas/media/video-interface-devices.yaml#

properties:
  compatible:
    const: samsung,s5k3t1

  reg:
    maxItems: 1

  clocks:
    description:
      Input clock (EXTCLK).
    maxItems: 1

  reset-gpios:
    description: Active low GPIO connected to the RESET pad of the sensor.
    maxItems: 1

  vana-supply:
    description: Analog power supply (2.8 V).

  vdig-supply:
    description: Digital core power supply.

  vio-supply:
    description: Digital I/O power supply (1.8 V).

  port:
    $ref: /schemas/graph.yaml#/$defs/port-base
    additionalProperties: false

    properties:
      endpoint:
        $ref: /schemas/media/video-interfaces.yaml#
        unevaluatedProperties: false

        properties:
          data-lanes:
            items:
              - const: 1
              - const: 2
              - const: 3
              - const: 4

          link-frequencies:
            items:
              - const: 300000000

        required:
          - data-lanes
          - link-frequencies

required:
  - compatible
  - reg
  - clocks
  - vana-supply
  - vdig-supply
  - vio-supply
  - port

unevaluatedProperties: false

examples:
  - |
    #include <dt-bindings/gpio/gpio.h>

    i2c {
        #address-cells = <1>;
        #size-cells = <0>;

        camera@2d {
            compatible = "samsung,s5k3t1";
            reg = <0x2d>;

            clocks = <&camera_mclk 0>;
            assigned-clocks = <&camera_mclk 0>;
            assigned-clock-rates = <24000000>;

            reset-gpios = <&tlmm 47 GPIO_ACTIVE_LOW>;

            vana-supply = <&vreg_2p8>;
            vdig-supply = <&vreg_1p2>;
            vio-supply = <&vreg_1p8>;

            orientation = <0>;
            rotation = <270>;

            port {
                endpoint {
                    data-lanes = <1 2 3 4>;
                    link-frequencies = /bits/ 64 <300000000>;
                    remote-endpoint = <&csiphy_ep>;
                };
            };
        };
    };
...
```

## Documentation/devicetree/bindings/media/i2c/samsung,s5k5e8.yaml
```yaml
# SPDX-License-Identifier: (GPL-2.0-only OR BSD-2-Clause)
%YAML 1.2
---
$id: http://devicetree.org/schemas/media/i2c/samsung,s5k5e8.yaml#
$schema: http://devicetree.org/meta-schemas/core.yaml#

title: Samsung S5K5E8 Image Sensor

maintainers:
  - Gianluca Boiano <morf3089@gmail.com>

description:
  Samsung S5K5E8 is a 5 MP (2592x1944) CMOS Bayer image sensor controlled
  over I2C (CCI) and sending RAW10 image data over a 2-lane MIPI CSI-2
  D-PHY interface.

allOf:
  - $ref: /schemas/media/video-interface-devices.yaml#

properties:
  compatible:
    const: samsung,s5k5e8

  reg:
    maxItems: 1

  clocks:
    description:
      Input clock (EXTCLK).
    maxItems: 1

  reset-gpios:
    description:
      Active low GPIO connected to the XSHUTDOWN pin of the sensor.
    maxItems: 1

  vana-supply:
    description: Analog power supply (2.8 V).

  vdig-supply:
    description: Digital core power supply.

  vio-supply:
    description: Interface power supply (1.8 V).

  port:
    $ref: /schemas/graph.yaml#/$defs/port-base
    additionalProperties: false

    properties:
      endpoint:
        $ref: /schemas/media/video-interfaces.yaml#
        unevaluatedProperties: false

        properties:
          data-lanes:
            items:
              - const: 1
              - const: 2

          link-frequencies:
            items:
              - const: 418000000

        required:
          - data-lanes
          - link-frequencies

required:
  - compatible
  - reg
  - clocks
  - vana-supply
  - vdig-supply
  - vio-supply
  - port

unevaluatedProperties: false

examples:
  - |
    #include <dt-bindings/gpio/gpio.h>

    i2c {
        #address-cells = <1>;
        #size-cells = <0>;

        camera@18 {
            compatible = "samsung,s5k5e8";
            reg = <0x18>;

            clocks = <&camss 1>;
            assigned-clocks = <&camss 1>;
            assigned-clock-rates = <24000000>;
            reset-gpios = <&tlmm 28 GPIO_ACTIVE_LOW>;

            vana-supply = <&cam_vana>;
            vdig-supply = <&cam_vdig>;
            vio-supply = <&cam_vio>;

            orientation = <0>;
            rotation = <270>;

            port {
                endpoint {
                    data-lanes = <1 2>;
                    link-frequencies = /bits/ 64 <418000000>;
                    remote-endpoint = <&csiphy_ep>;
                };
            };
        };
    };
...
```
